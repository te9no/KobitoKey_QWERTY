## boards/shields/KobitoKey/Kconfig.defconfig
```kconfig
# central - Left side
if SHIELD_KOBITOKEY_LEFT
config ZMK_KEYBOARD_NAME
    default "KobitoKey"
endif

if SHIELD_KOBITOKEY_LEFT || SHIELD_KOBITOKEY_RIGHT
config ZMK_SPLIT
    default y
config ZMK_POINTING
    default y
config SPI
    default y
endif
```

## config/west.yml
```yaml
manifest:
  remotes:
    - name: zmkfirmware
      url-base: https://github.com/zmkfirmware
    - name: badjeff
      url-base: https://github.com/badjeff
    - name: hsgw
      url-base: https://github.com/hsgw
    - name: caksoylar  # <-- led
      url-base: https://github.com/caksoylar  
    - name: kot149
      url-base: https://github.com/kot149

  projects:
    - name: zmk
      remote: zmkfirmware
      revision: v0.3
      import: app/west.yml

    - name: zmk-pmw3610-driver
      remote: badjeff
      revision: zmk-0.3
    
    - name: zmk-feature-sensor_rotation
      remote: hsgw
      revision: main

    - name: zmk-rgbled-widget  # <-- led
      remote: caksoylar
      revision: main
      
    - name: zmk-layout-shift
      remote: kot149
      revision: v1
  self:
    path: config
```
